#include <IRremote.h>
#include "Freenove_WS2812_Lib_for_ESP32.h"
#include <SPI.h>
#include <Wire.h>
#include <Adafruit_GFX.h>
#include <Adafruit_SSD1306.h>  
#include <Adafruit_I2CDevice.h>


#define MAX_Col_Val 255
#define LEDS_COUNT  60                                                                      
#define LEDS_PIN  2
#define CHANNEL   0
Freenove_ESP32_WS2812 strip = Freenove_ESP32_WS2812(LEDS_COUNT, LEDS_PIN, CHANNEL, TYPE_GRB); //Led strip setup 

#define SCREEN_WIDTH 128
#define SCREEN_HEIGHT 64
#define OLED_RESET -1
Adafruit_SSD1306 display(SCREEN_WIDTH, SCREEN_HEIGHT, &Wire, OLED_RESET);   //display setup                    


const byte IR_RECEIVE_PIN = 15;   //ir reciver setup

int color[6][3]={{0, 0, 0}, {0, 255, 0}, {0, 0, 255}, {255, 255, 255},{255, 0, 0},{0, 0, 0}}; 
String menu_setup[5]={"Red________", "Green______", "Blue_______", "Freqency___   Hz","Mode_______"};
int col_nr=0;
int freq=1;
int bright=20;
int space=3;
int row=1;
int address=0;
int col_r=0;
int col_g=0;
int col_b=0;
char prev_button=' ';
bool pressed_bttn=0;
bool single_mode=0;


static const unsigned char PROGMEM logo16_glcd_bmp[] =   //Logo PolSl
{0xff, 0xff, 0xff, 0xff, 0xff, 0xff, 0xff, 0xff, 0xff, 0xff, 0xff, 0xff, 0xff, 0xff, 0xff, 0xff, 
0xff, 0xff, 0xff, 0xff, 0xff, 0xff, 0xff, 0xff, 0xff, 0xff, 0xff, 0xfe, 0x03, 0xff, 0xff, 0xff, 
0xff, 0xff, 0xff, 0xff, 0xff, 0xff, 0xff, 0xff, 0xff, 0xff, 0xff, 0xfc, 0x03, 0xff, 0xff, 0xff, 
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0xff, 0xff, 0xff, 0xff, 0xff, 0xff, 0xff, 0xff, 0xff, 0xff, 0xff, 0xff, 0xff, 0xff, 0xff, 0xff
};

void Menu()
{ 

  color[5][0]=col_r;
  color[5][1]=col_g;
  color[5][2]=col_b;
  int menu_data[5] ={color[col_nr][0], color[col_nr][1], color[col_nr][2],freq,single_mode};     //tutaj if z spaceem
  display.clearDisplay();   // Clear the buffer.
  for (int i=0;i<5;i++)
    {
    display.setCursor(5, 10*i);
    display.println(menu_setup[i]);
    display.setCursor(71, 10*i);
    display.println(menu_data[i]);
    }
  if  (single_mode==0)
  {
    display.setCursor(5, 50);
    display.println("Space:");
    display.setCursor(45, 50);
    display.println(space);
    display.setCursor(60, 50);
    display.println("In a row:" );
    display.setCursor(115, 50);
    display.println(row);
  }
  else
  {
    display.setCursor(5, 50);
    display.println("Diode number:");
    display.setCursor(85, 50);
    display.println(address);  
  }
  display.display(); 
}


char Button()
{   
   char button=' ';
   if (IrReceiver.decode())
   {  
      switch(IrReceiver.decodedIRData.command)
      {
      case 69: button='1'; break; //1
      case 70: button='2'; break; //2
      case 71: button='3'; break; //3
      case 68: button='4'; break; //4
      case 64: button='5'; break; //5
      case 67: button='6'; break; //6
      case 7: button='7';  break; //7
      case 21: button='8'; break; //8
      case 9: button='9';  break; //9
      case 22: button='*'; break; //*
      case 25: button='0'; break; //0
      case 13: button='#';  break; //#
      case 24: button='u'; break;   //up
      case 8: button='l';  break;   //left
      case 28: button='k'; break;   //ok
      case 90: button='r'; break;   //right
      case 82: button='d'; break;   //down    
      default:   break;  
      }  
      IrReceiver.resume();
   }
   return button;
}

void setup() {
  Serial.begin(9600);                         //OLED setup
  display.begin(SSD1306_SWITCHCAPVCC, 0x3C);   // init done
  
  display.clearDisplay();                                 // Clear the buffer.
  display.drawBitmap(0,0, logo16_glcd_bmp, 128,64,WHITE); // show logo polsl
  display.display();
  delay(4000);

    
  display.clearDisplay();                // Clear the buffer.
  display.setTextSize(1);               // Draw 2X-scale text
  display.setTextColor(SSD1306_WHITE);    //init data
  Menu();


  
  Serial.begin(115200);                     //IR Recive setup
  Serial.println("IR Receive test");
  IrReceiver.begin(IR_RECEIVE_PIN, ENABLE_LED_FEEDBACK);

  strip.begin();            //strip setup
  strip.setBrightness(bright);  
}

void loop() {

  
  char button=Button();
   
  
  
  switch (button)
  {
    case 'u': if (freq >= 39) freq = 40; else freq++; break;
    case 'd': if (freq <= 2) freq = 1; else freq--; break;
    
    case 'r': if(single_mode==0)                                                            //jeżeli jesteśmy w trybie pojedynczej diody można strzałkami lewo/prawo sterować adresem diody
              if (col_nr >= 4) col_nr = 5; else col_nr++;  
              else if (address >= LEDS_COUNT-1) address = LEDS_COUNT; else address++;                          ///tutej
              break;
    case 'l': if(single_mode==0)
              if (col_nr <= 1) col_nr = 0; else col_nr--; 
              else if (address <= 1) address = 0; else address--;
              break;
    
    case '1': if (col_r >= MAX_Col_Val-1) col_r = MAX_Col_Val; else col_r++;  break;
    case '4': if (col_r <= 1) col_r = 0; else col_r--; break;
    
    case '2': if (col_g >= MAX_Col_Val-1) col_g = MAX_Col_Val; else col_g++; break;
    case '5': if (col_g <= 1) col_g = 0; else col_g--; break;    
    
    case '3': if (col_b >= MAX_Col_Val-1) col_b = MAX_Col_Val; else col_b++; break;
    case '6': if(col_b <= 1) col_b = 0; else col_b--; break;
    
    case '8': if (space >= 10) space = 11; else space++;  break;
    case '0': if (space <= 2) space = 1; else space--; break;
    
    case '9': if (row >= 10) row = 11; else row++;  break;
    case '7': if (row <= 1) row = 1; else row--; break;
    
    case '#': pressed_bttn = !pressed_bttn; break;
    case '*': single_mode = !single_mode; break;
    case 'k': break; 
    default:   break;  
  }
  if(prev_button!=button){Menu();}  

  
  if (not pressed_bttn){
    
    if (single_mode==0)
    {
      if (row==1)
        {
          for (int i = 0; i < LEDS_COUNT; i=i+space)
            {strip.setLedColorData(i, color[col_nr][0], color[col_nr][1], color[col_nr][2]);}    //pojedyncza dioda i przerwy
        }
        else
        {
          for (int i = 0; i < LEDS_COUNT; i=i+space+row){       //nie działa space i row coś się psuje, można dodać offset i sterowanie jedną diodą dla spaceu 60. np zamiast 11 przy if to 60 i wtedy jedna dioda 
           for (int j = 0; j <= row; j++){strip.setLedColorData(i+j, color[col_nr][0], color[col_nr][1], color[col_nr][2]);}}    //rząd diód i przerwy
        }           
        strip.show();
        delay(500/freq); 
         
        for (int i = 0; i < LEDS_COUNT; i++) 
          {strip.setLedColorData(i,color[0][0], color[0][1], color[0][2]);}   //wyłączanie diód         
        strip.show();
        delay(500/freq); 
    }
    else
    {
      strip.setLedColorData(address, color[col_nr][0], color[col_nr][1], color[col_nr][2]);   //Zapalenie pojedynczej diody o danym adresie oraz danym kolorze 
      strip.show();
      delay(500/freq); 
      
      strip.setLedColorData(address,color[0][0], color[0][1], color[0][2]);   //wyłączanie diód      
      strip.show();
      delay(500/freq); 
    }}
  
  prev_button=button;
 }
